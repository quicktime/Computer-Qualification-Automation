[ ] 
[ ] // This one is used by D6780 Customize Test Result
[+] type REC_1ANALYTE is record
	[ ] STRING NAME  
	[ ] STRING AnalyteName1 
	[ ] STRING Reporter1 
	[ ] INTEGER NumberCyclesInStage
	[ ] INTEGER BkgndSub  
	[ ] INTEGER BkgndVMin1 
	[ ] INTEGER BkgndVMax1 
	[ ] REAL Threshold1 
	[ ] INTEGER Boxcar1 
	[ ] STRING CurveAnalysis1
	[ ] INTEGER NormFactor1
	[ ] INTEGER VMin1 
	[ ] INTEGER VMax1 
	[ ] STRING Ausage1 
	[ ] INTEGER UseEndPt1
	[ ] INTEGER EndPt1
	[ ] STRING  InvalidBias1
	[ ] STRING PeakHeightMin1
	[ ] INTEGER UseMinTargetDeltaCt1
	[ ] STRING MinTargetDeltaCt1
	[ ] STRING DeltaCtE1
	[ ] STRING CurveFit
	[ ] STRING SignalLoss
[ ] 
[ ] // This one is used by D6780 Customize Test Result
[+] type REC_2ANALYTES is record
	[ ] STRING NAME  
	[ ] STRING AnalyteName1 
	[ ] STRING Reporter1 
	[ ] STRING AnalyteName2 
	[ ] STRING Reporter2 
	[ ] INTEGER NumberCyclesInStage
	[ ] INTEGER BkgndSub  
	[ ] INTEGER BkgndVMin1 
	[ ] INTEGER BkgndVMax1 
	[ ] INTEGER BkgndVMin2  
	[ ] INTEGER BkgndVMax2 
	[ ] REAL Threshold1 
	[ ] REAL Threshold2 
	[ ] INTEGER Boxcar1 
	[ ] INTEGER Boxcar2 
	[ ] STRING CurveAnalysis1
	[ ] STRING CurveAnalysis2
	[ ] INTEGER NormFactor1
	[ ] INTEGER NormFactor2
	[ ] INTEGER VMin1 
	[ ] INTEGER VMax1 
	[ ] INTEGER VMin2  
	[ ] INTEGER VMax2 
	[ ] STRING Ausage1 
	[ ] STRING Ausage2  
	[ ] INTEGER UseEndPt1
	[ ] INTEGER UseEndPt2
	[ ] INTEGER EndPt1
	[ ] INTEGER EndPt2
	[ ] INTEGER AnalyteTargetIC1
	[ ] INTEGER SelectTarget1ForIC
	[ ] INTEGER AnalyteTargetSPC1
	[ ] INTEGER SelectTarget1ForSPC
	[ ] INTEGER AnalyteTargetEC1
	[ ] INTEGER SelectTarget1ForEC
	[ ] STRING  InvalidBias1
	[ ] STRING  InvalidBias2
	[ ] STRING PeakHeightMin1
	[ ] STRING PeakHeightMin2
	[ ] INTEGER UseMinTargetDeltaCt1
	[ ] INTEGER UseMinTargetDeltaCt2
	[ ] STRING MinTargetDeltaCt1
	[ ] STRING MinTargetDeltaCt2
	[ ] STRING DeltaCtE1
	[ ] STRING DeltaCtE2
	[ ] STRING CurveFit
	[ ] STRING SignalLoss
	[ ] STRING ResultText11
	[ ] STRING ResultColor11
	[ ] STRING ResultText12
	[ ] STRING ResultColor12
	[ ] STRING ResultText13
	[ ] STRING ResultColor13
	[ ] STRING ResultText21
	[ ] STRING ResultColor21
	[ ] STRING ResultText22
	[ ] STRING ResultColor22
	[ ] STRING ResultText23
	[ ] STRING ResultColor23
	[ ] STRING OrganismName1
	[ ] STRING OrganismName2
	[ ] INTEGER AnalyteCheck1
	[ ] INTEGER AnalyteCheck2
	[ ] STRING sDefaultResultText
	[ ] STRING sDefaultResultColor
[ ] 
[ ] // This one is used by D6780 Customize Test Result
[+] type REC_3ANALYTES is record
	[ ] STRING NAME  
	[ ] STRING AnalyteName1 
	[ ] STRING Reporter1 
	[ ] STRING AnalyteName2 
	[ ] STRING Reporter2 
	[ ] STRING AnalyteName3 
	[ ] STRING Reporter3 
	[ ] INTEGER NumberCyclesInStage
	[ ] INTEGER BkgndSub  
	[ ] INTEGER BkgndVMin1 
	[ ] INTEGER BkgndVMax1 
	[ ] INTEGER BkgndVMin2  
	[ ] INTEGER BkgndVMax2 
	[ ] INTEGER BkgndVMin3 
	[ ] INTEGER BkgndVMax3 
	[ ] REAL Threshold1 
	[ ] REAL Threshold2 
	[ ] REAL Threshold3 
	[ ] INTEGER Boxcar1 
	[ ] INTEGER Boxcar2 
	[ ] INTEGER Boxcar3 
	[ ] STRING CurveAnalysis1
	[ ] STRING CurveAnalysis2
	[ ] STRING CurveAnalysis3
	[ ] INTEGER NormFactor1
	[ ] INTEGER NormFactor2
	[ ] INTEGER NormFactor3
	[ ] INTEGER VMin1 
	[ ] INTEGER VMax1 
	[ ] INTEGER VMin2  
	[ ] INTEGER VMax2 
	[ ] INTEGER VMin3 
	[ ] INTEGER VMax3 
	[ ] STRING Ausage1 
	[ ] STRING Ausage2  
	[ ] STRING Ausage3 
	[ ] INTEGER UseEndPt1
	[ ] INTEGER UseEndPt2
	[ ] INTEGER UseEndPt3
	[ ] INTEGER EndPt1
	[ ] INTEGER EndPt2
	[ ] INTEGER EndPt3
	[ ] INTEGER AnalyteTargetIC1
	[ ] INTEGER SelectTarget1ForIC
	[ ] INTEGER AnalyteTargetIC2
	[ ] INTEGER SelectTarget2ForIC  
	[ ] INTEGER AnalyteTargetSPC1
	[ ] INTEGER SelectTarget1ForSPC
	[ ] INTEGER AnalyteTargetSPC2
	[ ] INTEGER SelectTarget2ForSPC
	[ ] INTEGER AnalyteTargetEC1
	[ ] INTEGER SelectTarget1ForEC
	[ ] INTEGER AnalyteTargetEC2
	[ ] INTEGER SelectTarget2ForEC
	[ ] STRING  InvalidBias1
	[ ] STRING  InvalidBias2
	[ ] STRING  InvalidBias3
	[ ] STRING PeakHeightMin1
	[ ] STRING PeakHeightMin2
	[ ] STRING PeakHeightMin3
	[ ] INTEGER UseMinTargetDeltaCt1
	[ ] INTEGER UseMinTargetDeltaCt2
	[ ] INTEGER UseMinTargetDeltaCt3
	[ ] STRING MinTargetDeltaCt1
	[ ] STRING MinTargetDeltaCt2
	[ ] STRING MinTargetDeltaCt3
	[ ] STRING DeltaCtE1
	[ ] STRING DeltaCtE2
	[ ] STRING DeltaCtE3
	[ ] STRING CurveFit
	[ ] STRING SignalLoss
[ ] 
[ ] // This one is used by D6780 Customize Test Result
[+] type REC_3ANALYTES_PRB_CHK is record
	[ ] STRING NAME  
	[ ] STRING AnalyteName1 
	[ ] STRING Reporter1 
	[ ] STRING AnalyteName2 
	[ ] STRING Reporter2 
	[ ] STRING AnalyteName3 
	[ ] STRING Reporter3 
	[ ] INTEGER NumberCyclesInStage
	[ ] INTEGER BkgndSub  
	[ ] INTEGER BkgndVMin1 
	[ ] INTEGER BkgndVMax1 
	[ ] INTEGER BkgndVMin2  
	[ ] INTEGER BkgndVMax2 
	[ ] INTEGER BkgndVMin3 
	[ ] INTEGER BkgndVMax3 
	[ ] REAL Threshold1 
	[ ] REAL Threshold2 
	[ ] REAL Threshold3 
	[ ] INTEGER Boxcar1 
	[ ] INTEGER Boxcar2 
	[ ] INTEGER Boxcar3 
	[ ] STRING CurveAnalysis1
	[ ] STRING CurveAnalysis2
	[ ] STRING CurveAnalysis3
	[ ] INTEGER NormFactor1
	[ ] INTEGER NormFactor2
	[ ] INTEGER NormFactor3
	[ ] INTEGER VMin1 
	[ ] INTEGER VMax1 
	[ ] INTEGER VMin2  
	[ ] INTEGER VMax2 
	[ ] INTEGER VMin3 
	[ ] INTEGER VMax3 
	[ ] STRING Ausage1 
	[ ] STRING Ausage2  
	[ ] STRING Ausage3 
	[ ] INTEGER UseEndPt1
	[ ] INTEGER UseEndPt2
	[ ] INTEGER UseEndPt3
	[ ] INTEGER EndPt1
	[ ] INTEGER EndPt2
	[ ] INTEGER EndPt3
	[ ] INTEGER AnalyteTargetIC1
	[ ] INTEGER SelectTarget1ForIC
	[ ] INTEGER AnalyteTargetIC2
	[ ] INTEGER SelectTarget2ForIC  
	[ ] INTEGER AnalyteTargetSPC1
	[ ] INTEGER SelectTarget1ForSPC
	[ ] INTEGER AnalyteTargetSPC2
	[ ] INTEGER SelectTarget2ForSPC
	[ ] INTEGER AnalyteTargetEC1
	[ ] INTEGER SelectTarget1ForEC
	[ ] INTEGER AnalyteTargetEC2
	[ ] INTEGER SelectTarget2ForEC
	[ ] STRING  InvalidBias1
	[ ] STRING  InvalidBias2
	[ ] STRING  InvalidBias3
	[ ] STRING PeakHeightMin1
	[ ] STRING PeakHeightMin2
	[ ] STRING PeakHeightMin3
	[ ] INTEGER UseMinTargetDeltaCt1
	[ ] INTEGER UseMinTargetDeltaCt2
	[ ] INTEGER UseMinTargetDeltaCt3
	[ ] STRING MinTargetDeltaCt1
	[ ] STRING MinTargetDeltaCt2
	[ ] STRING MinTargetDeltaCt3
	[ ] STRING DeltaCtE1
	[ ] STRING DeltaCtE2
	[ ] STRING DeltaCtE3
	[ ] STRING CurveFit
	[ ] STRING SignalLoss
	[ ] INTEGER PrbChk13Max1
	[ ] INTEGER PrbChk13Max2
	[ ] INTEGER PrbChk13Max3
	[ ] INTEGER PrbChk2Min1
	[ ] INTEGER PrbChk2Min2
	[ ] INTEGER PrbChk2Min3
	[ ] 
[ ] 
[ ] // This one is used by D6780 Customize Test Result
[+] type REC_4ANALYTES is record
	[ ] STRING NAME  
	[ ] STRING AnalyteName1 
	[ ] STRING Reporter1 
	[ ] STRING AnalyteName2 
	[ ] STRING Reporter2 
	[ ] STRING AnalyteName3 
	[ ] STRING Reporter3 
	[ ] STRING AnalyteName4 
	[ ] STRING Reporter4 
	[ ] INTEGER NumberCyclesInStage
	[ ] INTEGER BkgndSub  
	[ ] INTEGER BkgndVMin1 
	[ ] INTEGER BkgndVMax1 
	[ ] INTEGER BkgndVMin2  
	[ ] INTEGER BkgndVMax2 
	[ ] INTEGER BkgndVMin3 
	[ ] INTEGER BkgndVMax3 
	[ ] INTEGER BkgndVMin4 
	[ ] INTEGER BkgndVMax4
	[ ] REAL Threshold1 
	[ ] REAL Threshold2 
	[ ] REAL Threshold3 
	[ ] REAL Threshold4 
	[ ] INTEGER Boxcar1 
	[ ] INTEGER Boxcar2 
	[ ] INTEGER Boxcar3 
	[ ] INTEGER Boxcar4 
	[ ] STRING CurveAnalysis1
	[ ] STRING CurveAnalysis2
	[ ] STRING CurveAnalysis3
	[ ] STRING CurveAnalysis4
	[ ] INTEGER NormFactor1
	[ ] INTEGER NormFactor2
	[ ] INTEGER NormFactor3
	[ ] INTEGER NormFactor4
	[ ] INTEGER VMin1 
	[ ] INTEGER VMax1 
	[ ] INTEGER VMin2  
	[ ] INTEGER VMax2 
	[ ] INTEGER VMin3 
	[ ] INTEGER VMax3 
	[ ] INTEGER VMin4 
	[ ] INTEGER VMax4 
	[ ] STRING Ausage1 
	[ ] STRING Ausage2  
	[ ] STRING Ausage3 
	[ ] STRING Ausage4 
	[ ] INTEGER UseEndPt1
	[ ] INTEGER UseEndPt2
	[ ] INTEGER UseEndPt3
	[ ] INTEGER UseEndPt4
	[ ] INTEGER EndPt1
	[ ] INTEGER EndPt2
	[ ] INTEGER EndPt3
	[ ] INTEGER EndPt4
	[ ] INTEGER AnalyteTargetIC1
	[ ] INTEGER SelectTarget1ForIC
	[ ] INTEGER AnalyteTargetIC2
	[ ] INTEGER SelectTarget2ForIC  
	[ ] INTEGER AnalyteTargetIC3
	[ ] INTEGER SelectTarget3ForIC  
	[ ] INTEGER AnalyteTargetSPC1
	[ ] INTEGER SelectTarget1ForSPC
	[ ] INTEGER AnalyteTargetSPC2
	[ ] INTEGER SelectTarget2ForSPC
	[ ] INTEGER AnalyteTargetSPC3
	[ ] INTEGER SelectTarget3ForSPC
	[ ] INTEGER AnalyteTargetEC1
	[ ] INTEGER SelectTarget1ForEC
	[ ] INTEGER AnalyteTargetEC2
	[ ] INTEGER SelectTarget2ForEC
	[ ] INTEGER AnalyteTargetEC3
	[ ] INTEGER SelectTarget3ForEC
	[ ] STRING  InvalidBias1
	[ ] STRING  InvalidBias2
	[ ] STRING  InvalidBias3
	[ ] STRING  InvalidBias4
	[ ] STRING PeakHeightMin1
	[ ] STRING PeakHeightMin2
	[ ] STRING PeakHeightMin3
	[ ] STRING PeakHeightMin4
	[ ] INTEGER UseMinTargetDeltaCt1
	[ ] INTEGER UseMinTargetDeltaCt2
	[ ] INTEGER UseMinTargetDeltaCt3
	[ ] INTEGER UseMinTargetDeltaCt4
	[ ] STRING MinTargetDeltaCt1
	[ ] STRING MinTargetDeltaCt2
	[ ] STRING MinTargetDeltaCt3
	[ ] STRING MinTargetDeltaCt4
	[ ] STRING DeltaCtE1
	[ ] STRING DeltaCtE2
	[ ] STRING DeltaCtE3
	[ ] STRING DeltaCtE4
	[ ] STRING CurveFit
	[ ] STRING SignalLoss
[ ] 
[ ] // This one is used by D6780 Customize Test Result
[+] type REC_5ANALYTES is record
	[ ] STRING NAME  
	[ ] STRING AnalyteName1 
	[ ] STRING Reporter1 
	[ ] STRING AnalyteName2 
	[ ] STRING Reporter2 
	[ ] STRING AnalyteName3 
	[ ] STRING Reporter3 
	[ ] STRING AnalyteName4 
	[ ] STRING Reporter4 
	[ ] STRING AnalyteName5 
	[ ] STRING Reporter5 
	[ ] INTEGER NumberCyclesInStage
	[ ] INTEGER BkgndSub  
	[ ] INTEGER BkgndVMin1 
	[ ] INTEGER BkgndVMax1 
	[ ] INTEGER BkgndVMin2  
	[ ] INTEGER BkgndVMax2 
	[ ] INTEGER BkgndVMin3 
	[ ] INTEGER BkgndVMax3 
	[ ] INTEGER BkgndVMin4  
	[ ] INTEGER BkgndVMax4 
	[ ] INTEGER BkgndVMin5 
	[ ] INTEGER BkgndVMax5 
	[ ] REAL Threshold1 
	[ ] REAL Threshold2 
	[ ] REAL Threshold3 
	[ ] REAL Threshold4 
	[ ] REAL Threshold5 
	[ ] INTEGER Boxcar1 
	[ ] INTEGER Boxcar2 
	[ ] INTEGER Boxcar3 
	[ ] INTEGER Boxcar4 
	[ ] INTEGER Boxcar5 
	[ ] STRING CurveAnalysis1
	[ ] STRING CurveAnalysis2
	[ ] STRING CurveAnalysis3
	[ ] STRING CurveAnalysis4
	[ ] STRING CurveAnalysis5
	[ ] INTEGER NormFactor1
	[ ] INTEGER NormFactor2
	[ ] INTEGER NormFactor3
	[ ] INTEGER NormFactor4
	[ ] INTEGER NormFactor5
	[ ] INTEGER VMin1 
	[ ] INTEGER VMax1 
	[ ] INTEGER VMin2  
	[ ] INTEGER VMax2 
	[ ] INTEGER VMin3 
	[ ] INTEGER VMax3 
	[ ] INTEGER VMin4  
	[ ] INTEGER VMax4 
	[ ] INTEGER VMin5 
	[ ] INTEGER VMax5 
	[ ] STRING Ausage1 
	[ ] STRING Ausage2  
	[ ] STRING Ausage3 
	[ ] STRING Ausage4  
	[ ] STRING Ausage5 
	[ ] INTEGER UseEndPt1
	[ ] INTEGER UseEndPt2
	[ ] INTEGER UseEndPt3
	[ ] INTEGER UseEndPt4
	[ ] INTEGER UseEndPt5
	[ ] INTEGER EndPt1
	[ ] INTEGER EndPt2
	[ ] INTEGER EndPt3
	[ ] INTEGER EndPt4
	[ ] INTEGER EndPt5
	[ ] INTEGER AnalyteTargetIC1
	[ ] INTEGER SelectTarget1ForIC
	[ ] INTEGER AnalyteTargetIC2
	[ ] INTEGER SelectTarget2ForIC  
	[ ] INTEGER AnalyteTargetIC3
	[ ] INTEGER SelectTarget3ForIC
	[ ] INTEGER AnalyteTargetIC4
	[ ] INTEGER SelectTarget4ForIC  
	[ ] INTEGER AnalyteTargetSPC1
	[ ] INTEGER SelectTarget1ForSPC
	[ ] INTEGER AnalyteTargetSPC2
	[ ] INTEGER SelectTarget2ForSPC
	[ ] INTEGER AnalyteTargetSPC3
	[ ] INTEGER SelectTarget3ForSPC
	[ ] INTEGER AnalyteTargetSPC4
	[ ] INTEGER SelectTarget4ForSPC
	[ ] INTEGER AnalyteTargetEC1
	[ ] INTEGER SelectTarget1ForEC
	[ ] INTEGER AnalyteTargetEC2
	[ ] INTEGER SelectTarget2ForEC
	[ ] INTEGER AnalyteTargetEC3
	[ ] INTEGER SelectTarget3ForEC
	[ ] INTEGER AnalyteTargetEC4
	[ ] INTEGER SelectTarget4ForEC
	[ ] STRING  InvalidBias1
	[ ] STRING  InvalidBias2
	[ ] STRING  InvalidBias3
	[ ] STRING  InvalidBias4
	[ ] STRING  InvalidBias5
	[ ] STRING PeakHeightMin1
	[ ] STRING PeakHeightMin2
	[ ] STRING PeakHeightMin3
	[ ] STRING PeakHeightMin4
	[ ] STRING PeakHeightMin5
	[ ] INTEGER UseMinTargetDeltaCt1
	[ ] INTEGER UseMinTargetDeltaCt2
	[ ] INTEGER UseMinTargetDeltaCt3
	[ ] INTEGER UseMinTargetDeltaCt4
	[ ] INTEGER UseMinTargetDeltaCt5
	[ ] STRING MinTargetDeltaCt1
	[ ] STRING MinTargetDeltaCt2
	[ ] STRING MinTargetDeltaCt3
	[ ] STRING MinTargetDeltaCt4
	[ ] STRING MinTargetDeltaCt5
	[ ] STRING DeltaCtE1
	[ ] STRING DeltaCtE2
	[ ] STRING DeltaCtE3
	[ ] STRING DeltaCtE4
	[ ] STRING DeltaCtE5
	[ ] STRING CurveFit
	[ ] STRING SignalLoss
[ ] 
[ ] // This one is used by D6780 Customize Test Result
[+] type REC_6ANALYTES is record
	[ ] STRING NAME  
	[ ] STRING AnalyteName1 
	[ ] STRING Reporter1 
	[ ] STRING AnalyteName2 
	[ ] STRING Reporter2 
	[ ] STRING AnalyteName3 
	[ ] STRING Reporter3 
	[ ] STRING AnalyteName4 
	[ ] STRING Reporter4 
	[ ] STRING AnalyteName5 
	[ ] STRING Reporter5 
	[ ] STRING AnalyteName6 
	[ ] STRING Reporter6 
	[ ] INTEGER NumberCyclesInStage
	[ ] INTEGER BkgndSub  
	[ ] INTEGER BkgndVMin1 
	[ ] INTEGER BkgndVMax1 
	[ ] INTEGER BkgndVMin2  
	[ ] INTEGER BkgndVMax2 
	[ ] INTEGER BkgndVMin3 
	[ ] INTEGER BkgndVMax3 
	[ ] INTEGER BkgndVMin4 
	[ ] INTEGER BkgndVMax4
	[ ] INTEGER BkgndVMin5 
	[ ] INTEGER BkgndVMax5
	[ ] INTEGER BkgndVMin6 
	[ ] INTEGER BkgndVMax6
	[ ] REAL Threshold1 
	[ ] REAL Threshold2 
	[ ] REAL Threshold3 
	[ ] REAL Threshold4 
	[ ] REAL Threshold5 
	[ ] REAL Threshold6 
	[ ] INTEGER Boxcar1 
	[ ] INTEGER Boxcar2 
	[ ] INTEGER Boxcar3 
	[ ] INTEGER Boxcar4 
	[ ] INTEGER Boxcar5 
	[ ] INTEGER Boxcar6 
	[ ] STRING CurveAnalysis1
	[ ] STRING CurveAnalysis2
	[ ] STRING CurveAnalysis3
	[ ] STRING CurveAnalysis4
	[ ] STRING CurveAnalysis5
	[ ] STRING CurveAnalysis6
	[ ] INTEGER NormFactor1
	[ ] INTEGER NormFactor2
	[ ] INTEGER NormFactor3
	[ ] INTEGER NormFactor4
	[ ] INTEGER NormFactor5
	[ ] INTEGER NormFactor6
	[ ] INTEGER VMin1 
	[ ] INTEGER VMax1 
	[ ] INTEGER VMin2  
	[ ] INTEGER VMax2 
	[ ] INTEGER VMin3 
	[ ] INTEGER VMax3 
	[ ] INTEGER VMin4 
	[ ] INTEGER VMax4 
	[ ] INTEGER VMin5 
	[ ] INTEGER VMax5 
	[ ] INTEGER VMin6 
	[ ] INTEGER VMax6 
	[ ] STRING Ausage1 
	[ ] STRING Ausage2  
	[ ] STRING Ausage3 
	[ ] STRING Ausage4 
	[ ] STRING Ausage5 
	[ ] STRING Ausage6 
	[ ] INTEGER UseEndPt1
	[ ] INTEGER UseEndPt2
	[ ] INTEGER UseEndPt3
	[ ] INTEGER UseEndPt4
	[ ] INTEGER UseEndPt5
	[ ] INTEGER UseEndPt6
	[ ] INTEGER EndPt1
	[ ] INTEGER EndPt2
	[ ] INTEGER EndPt3
	[ ] INTEGER EndPt4
	[ ] INTEGER EndPt5
	[ ] INTEGER EndPt6
	[ ] INTEGER AnalyteTargetIC1
	[ ] INTEGER SelectTarget1ForIC
	[ ] INTEGER AnalyteTargetIC2
	[ ] INTEGER SelectTarget2ForIC  
	[ ] INTEGER AnalyteTargetIC3
	[ ] INTEGER SelectTarget3ForIC  
	[ ] INTEGER AnalyteTargetIC4
	[ ] INTEGER SelectTarget4ForIC 
	[ ] INTEGER AnalyteTargetIC5
	[ ] INTEGER SelectTarget5ForIC 
	[ ] INTEGER AnalyteTargetSPC1
	[ ] INTEGER SelectTarget1ForSPC
	[ ] INTEGER AnalyteTargetSPC2
	[ ] INTEGER SelectTarget2ForSPC
	[ ] INTEGER AnalyteTargetSPC3
	[ ] INTEGER SelectTarget3ForSPC
	[ ] INTEGER AnalyteTargetSPC4
	[ ] INTEGER SelectTarget4ForSPC 
	[ ] INTEGER AnalyteTargetSPC5
	[ ] INTEGER SelectTarget5ForSPC 
	[ ] INTEGER AnalyteTargetEC1
	[ ] INTEGER SelectTarget1ForEC
	[ ] INTEGER AnalyteTargetEC2
	[ ] INTEGER SelectTarget2ForEC
	[ ] INTEGER AnalyteTargetEC3
	[ ] INTEGER SelectTarget3ForEC
	[ ] INTEGER AnalyteTargetEC4
	[ ] INTEGER SelectTarget4ForEC
	[ ] INTEGER AnalyteTargetEC5
	[ ] INTEGER SelectTarget5ForEC
	[ ] STRING  InvalidBias1
	[ ] STRING  InvalidBias2
	[ ] STRING  InvalidBias3
	[ ] STRING  InvalidBias4
	[ ] STRING  InvalidBias5
	[ ] STRING  InvalidBias6
	[ ] STRING PeakHeightMin1
	[ ] STRING PeakHeightMin2
	[ ] STRING PeakHeightMin3
	[ ] STRING PeakHeightMin4
	[ ] STRING PeakHeightMin5
	[ ] STRING PeakHeightMin6
	[ ] INTEGER UseMinTargetDeltaCt1
	[ ] INTEGER UseMinTargetDeltaCt2
	[ ] INTEGER UseMinTargetDeltaCt3
	[ ] INTEGER UseMinTargetDeltaCt4
	[ ] INTEGER UseMinTargetDeltaCt5
	[ ] INTEGER UseMinTargetDeltaCt6
	[ ] STRING MinTargetDeltaCt1
	[ ] STRING MinTargetDeltaCt2
	[ ] STRING MinTargetDeltaCt3
	[ ] STRING MinTargetDeltaCt4
	[ ] STRING MinTargetDeltaCt5
	[ ] STRING MinTargetDeltaCt6
	[ ] STRING DeltaCtE1
	[ ] STRING DeltaCtE2
	[ ] STRING DeltaCtE3
	[ ] STRING DeltaCtE4
	[ ] STRING DeltaCtE5
	[ ] STRING DeltaCtE6
	[ ] STRING CurveFit
	[ ] STRING SignalLoss
[ ] 
[ ] // This one is used by D6780 Customize Test Result
[+] type REC_6TARGETS is record
	[ ] STRING NAME  
	[ ] STRING AnalyteName1 
	[ ] STRING Reporter1 
	[ ] STRING AnalyteName2 
	[ ] STRING Reporter2 
	[ ] STRING AnalyteName3 
	[ ] STRING Reporter3 
	[ ] STRING AnalyteName4 
	[ ] STRING Reporter4 
	[ ] STRING AnalyteName5 
	[ ] STRING Reporter5 
	[ ] STRING AnalyteName6 
	[ ] STRING Reporter6 
	[ ] INTEGER NumberCyclesInStage
	[ ] INTEGER BkgndSub  
	[ ] INTEGER BkgndVMin1 
	[ ] INTEGER BkgndVMax1 
	[ ] INTEGER BkgndVMin2  
	[ ] INTEGER BkgndVMax2 
	[ ] INTEGER BkgndVMin3 
	[ ] INTEGER BkgndVMax3 
	[ ] INTEGER BkgndVMin4  
	[ ] INTEGER BkgndVMax4 
	[ ] INTEGER BkgndVMin5 
	[ ] INTEGER BkgndVMax5 
	[ ] INTEGER BkgndVMin6 
	[ ] INTEGER BkgndVMax6 
	[ ] REAL Threshold1 
	[ ] REAL Threshold2 
	[ ] REAL Threshold3 
	[ ] REAL Threshold4 
	[ ] REAL Threshold5 
	[ ] REAL Threshold6 
	[ ] INTEGER Boxcar1 
	[ ] INTEGER Boxcar2 
	[ ] INTEGER Boxcar3 
	[ ] INTEGER Boxcar4 
	[ ] INTEGER Boxcar5 
	[ ] INTEGER Boxcar6 
	[ ] STRING CurveAnalysis1
	[ ] STRING CurveAnalysis2
	[ ] STRING CurveAnalysis3
	[ ] STRING CurveAnalysis4
	[ ] STRING CurveAnalysis5
	[ ] STRING CurveAnalysis6
	[ ] INTEGER NormFactor1
	[ ] INTEGER NormFactor2
	[ ] INTEGER NormFactor3
	[ ] INTEGER NormFactor4
	[ ] INTEGER NormFactor5
	[ ] INTEGER NormFactor6
	[ ] INTEGER VMin1 
	[ ] INTEGER VMax1 
	[ ] INTEGER VMin2  
	[ ] INTEGER VMax2 
	[ ] INTEGER VMin3 
	[ ] INTEGER VMax3 
	[ ] INTEGER VMin4  
	[ ] INTEGER VMax4 
	[ ] INTEGER VMin5 
	[ ] INTEGER VMax5 
	[ ] INTEGER VMin6 
	[ ] INTEGER VMax6 
	[ ] STRING Ausage1 
	[ ] STRING Ausage2  
	[ ] STRING Ausage3 
	[ ] STRING Ausage4  
	[ ] STRING Ausage5 
	[ ] STRING Ausage6 
	[ ] INTEGER UseEndPt1
	[ ] INTEGER UseEndPt2
	[ ] INTEGER UseEndPt3
	[ ] INTEGER UseEndPt4
	[ ] INTEGER UseEndPt5
	[ ] INTEGER UseEndPt6
	[ ] INTEGER EndPt1
	[ ] INTEGER EndPt2
	[ ] INTEGER EndPt3
	[ ] INTEGER EndPt4
	[ ] INTEGER EndPt5
	[ ] INTEGER EndPt6
	[ ] INTEGER AnalyteTargetIC1
	[ ] INTEGER SelectTarget1ForIC
	[ ] INTEGER AnalyteTargetIC2
	[ ] INTEGER SelectTarget2ForIC  
	[ ] INTEGER AnalyteTargetIC3
	[ ] INTEGER SelectTarget3ForIC
	[ ] INTEGER AnalyteTargetIC4
	[ ] INTEGER SelectTarget4ForIC  
	[ ] INTEGER AnalyteTargetIC5
	[ ] INTEGER SelectTarget5ForIC  
	[ ] INTEGER AnalyteTargetSPC1
	[ ] INTEGER SelectTarget1ForSPC
	[ ] INTEGER AnalyteTargetSPC2
	[ ] INTEGER SelectTarget2ForSPC
	[ ] INTEGER AnalyteTargetSPC3
	[ ] INTEGER SelectTarget3ForSPC
	[ ] INTEGER AnalyteTargetSPC4
	[ ] INTEGER SelectTarget4ForSPC
	[ ] INTEGER AnalyteTargetSPC5
	[ ] INTEGER SelectTarget5ForSPC
	[ ] INTEGER AnalyteTargetEC1
	[ ] INTEGER SelectTarget1ForEC
	[ ] INTEGER AnalyteTargetEC2
	[ ] INTEGER SelectTarget2ForEC
	[ ] INTEGER AnalyteTargetEC3
	[ ] INTEGER SelectTarget3ForEC
	[ ] INTEGER AnalyteTargetEC4
	[ ] INTEGER SelectTarget4ForEC
	[ ] INTEGER AnalyteTargetEC5
	[ ] INTEGER SelectTarget5ForEC
	[ ] STRING  InvalidBias1
	[ ] STRING  InvalidBias2
	[ ] STRING  InvalidBias3
	[ ] STRING  InvalidBias4
	[ ] STRING  InvalidBias5
	[ ] STRING  InvalidBias6
	[ ] STRING PeakHeightMin1
	[ ] STRING PeakHeightMin2
	[ ] STRING PeakHeightMin3
	[ ] STRING PeakHeightMin4
	[ ] STRING PeakHeightMin5
	[ ] STRING PeakHeightMin6
	[ ] INTEGER UseMinTargetDeltaCt1
	[ ] INTEGER UseMinTargetDeltaCt2
	[ ] INTEGER UseMinTargetDeltaCt3
	[ ] INTEGER UseMinTargetDeltaCt4
	[ ] INTEGER UseMinTargetDeltaCt5
	[ ] INTEGER UseMinTargetDeltaCt6
	[ ] STRING MinTargetDeltaCt1
	[ ] STRING MinTargetDeltaCt2
	[ ] STRING MinTargetDeltaCt3
	[ ] STRING MinTargetDeltaCt4
	[ ] STRING MinTargetDeltaCt5
	[ ] STRING MinTargetDeltaCt6
	[ ] STRING DeltaCtE1
	[ ] STRING DeltaCtE2
	[ ] STRING DeltaCtE3
	[ ] STRING DeltaCtE4
	[ ] STRING DeltaCtE5
	[ ] STRING DeltaCtE6
	[ ] STRING CurveFit
	[ ] STRING SignalLoss
[ ] 
[ ] // The _OR indicated that the type is used by D6781 Organism
[+] type REC_2ANALYTES_OR is record
	[ ] STRING sNAME  
	[ ] STRING sAnalyteName1 
	[ ] STRING sReporter1 
	[ ] STRING sAnalyteName2 
	[ ] STRING sReporter2 
	[ ] STRING sUsage1 
	[ ] STRING sUsage2  
	[ ] INTEGER iAnalyteTargetIC1
	[ ] INTEGER iSelectTarget1ForIC
	[ ] INTEGER iAnalyteTargetSPC1
	[ ] INTEGER iSelectTarget1ForSPC
	[ ] INTEGER iAnalyteTargetEC1
	[ ] INTEGER iSelectTarget1ForEC
	[ ] INTEGER iBkgndSub  
	[ ] INTEGER iBkgndVMin1 
	[ ] INTEGER iBkgndVMax1 
	[ ] INTEGER iBkgndVMin2  
	[ ] INTEGER iBkgndVMax2 
	[ ] REAL rThreshold1 
	[ ] REAL rThreshold2 
	[ ] STRING sCurveAnalysis1
	[ ] STRING sCurveAnalysis2
	[ ] INTEGER iBoxcar1 
	[ ] INTEGER iBoxcar2 
	[ ] INTEGER iVMin1 
	[ ] INTEGER iVMax1 
	[ ] INTEGER iVMin2  
	[ ] INTEGER iVMax2 
	[ ] INTEGER iUseEndPt1
	[ ] INTEGER iUseEndPt2
	[ ] INTEGER iEndPt1
	[ ] INTEGER iEndPt2
	[ ] INTEGER iCurveFit
	[ ] INTEGER iSignalLoss
	[ ] INTEGER iNumberCyclesInStage
	[ ] STRING sOrganismDetail
	[ ] STRING sDefaultResultText
	[ ] STRING sDefaultResultColor
[ ] 
[+] type REC_3ANALYTES_OR is record
	[ ] STRING sNAME  
	[ ] STRING sAnalyteName1 
	[ ] STRING sReporter1 
	[ ] STRING sAnalyteName2 
	[ ] STRING sReporter2 
	[ ] STRING sAnalyteName3 
	[ ] STRING sReporter3 
	[ ] STRING sUsage1 
	[ ] STRING sUsage2  
	[ ] STRING sUsage3 
	[ ] INTEGER iAnalyteTargetIC1
	[ ] INTEGER iSelectTarget1ForIC
	[ ] INTEGER iAnalyteTargetIC2
	[ ] INTEGER iSelectTarget2ForIC
	[ ] INTEGER iAnalyteTargetSPC1
	[ ] INTEGER iSelectTarget1ForSPC
	[ ] INTEGER iAnalyteTargetSPC2
	[ ] INTEGER iSelectTarget2ForSPC
	[ ] INTEGER iAnalyteTargetEC1
	[ ] INTEGER iSelectTarget1ForEC
	[ ] INTEGER iAnalyteTargetEC2
	[ ] INTEGER iSelectTarget2ForEC
	[ ] INTEGER iBkgndSub  
	[ ] INTEGER iBkgndVMin1 
	[ ] INTEGER iBkgndVMax1 
	[ ] INTEGER iBkgndVMin2  
	[ ] INTEGER iBkgndVMax2 
	[ ] INTEGER iBkgndVMin3 
	[ ] INTEGER iBkgndVMax3 
	[ ] REAL rThreshold1 
	[ ] REAL rThreshold2 
	[ ] REAL rThreshold3 
	[ ] STRING sCurveAnalysis1
	[ ] STRING sCurveAnalysis2
	[ ] STRING sCurveAnalysis3
	[ ] INTEGER iBoxcar1 
	[ ] INTEGER iBoxcar2 
	[ ] INTEGER iBoxcar3 
	[ ] INTEGER iVMin1 
	[ ] INTEGER iVMax1 
	[ ] INTEGER iVMin2  
	[ ] INTEGER iVMax2 
	[ ] INTEGER iVMin3 
	[ ] INTEGER iVMax3 
	[ ] INTEGER iUseEndPt1
	[ ] INTEGER iUseEndPt2
	[ ] INTEGER iUseEndPt3
	[ ] INTEGER iEndPt1
	[ ] INTEGER iEndPt2
	[ ] INTEGER iEndPt3
	[ ] INTEGER iCurveFit
	[ ] INTEGER iSignalLoss
	[ ] INTEGER iNumberCyclesInStage
	[ ] STRING sOrganismDetail
	[ ] STRING sDefaultResultText
	[ ] STRING sDefaultResultColor
[ ] 
[+] type REC_5ANALYTES_OR is record
	[ ] STRING sNAME  
	[ ] STRING sAnalyteName1 
	[ ] STRING sReporter1 
	[ ] STRING sAnalyteName2 
	[ ] STRING sReporter2 
	[ ] STRING sAnalyteName3 
	[ ] STRING sReporter3 
	[ ] STRING sAnalyteName4 
	[ ] STRING sReporter4 
	[ ] STRING sAnalyteName5 
	[ ] STRING sReporter5 
	[ ] STRING sUsage1 
	[ ] STRING sUsage2  
	[ ] STRING sUsage3 
	[ ] STRING sUsage4  
	[ ] STRING sUsage5 
	[ ] INTEGER iAnalyteTargetIC1
	[ ] INTEGER iSelectTarget1ForIC
	[ ] INTEGER iAnalyteTargetIC2
	[ ] INTEGER iSelectTarget2ForIC
	[ ] INTEGER iAnalyteTargetIC3
	[ ] INTEGER iSelectTarget3ForIC
	[ ] INTEGER iAnalyteTargetIC4
	[ ] INTEGER iSelectTarget4ForIC
	[ ] INTEGER iAnalyteTargetSPC1
	[ ] INTEGER iSelectTarget1ForSPC
	[ ] INTEGER iAnalyteTargetSPC2
	[ ] INTEGER iSelectTarget2ForSPC
	[ ] INTEGER iAnalyteTargetSPC3
	[ ] INTEGER iSelectTarget3ForSPC
	[ ] INTEGER iAnalyteTargetSPC4
	[ ] INTEGER iSelectTarget4ForSPC
	[ ] INTEGER iAnalyteTargetEC1
	[ ] INTEGER iSelectTarget1ForEC
	[ ] INTEGER iAnalyteTargetEC2
	[ ] INTEGER iSelectTarget2ForEC
	[ ] INTEGER iAnalyteTargetEC3
	[ ] INTEGER iSelectTarget3ForEC
	[ ] INTEGER iAnalyteTargetEC4
	[ ] INTEGER iSelectTarget4ForEC
	[ ] INTEGER iBkgndSub  
	[ ] INTEGER iBkgndVMin1 
	[ ] INTEGER iBkgndVMax1 
	[ ] INTEGER iBkgndVMin2  
	[ ] INTEGER iBkgndVMax2 
	[ ] INTEGER iBkgndVMin3 
	[ ] INTEGER iBkgndVMax3 
	[ ] INTEGER iBkgndVMin4  
	[ ] INTEGER iBkgndVMax4 
	[ ] INTEGER iBkgndVMin5 
	[ ] INTEGER iBkgndVMax5 
	[ ] REAL rThreshold1 
	[ ] REAL rThreshold2 
	[ ] REAL rThreshold3 
	[ ] REAL rThreshold4 
	[ ] REAL rThreshold5 
	[ ] STRING sCurveAnalysis1
	[ ] STRING sCurveAnalysis2
	[ ] STRING sCurveAnalysis3
	[ ] STRING sCurveAnalysis4
	[ ] STRING sCurveAnalysis5
	[ ] INTEGER iBoxcar1 
	[ ] INTEGER iBoxcar2 
	[ ] INTEGER iBoxcar3 
	[ ] INTEGER iBoxcar4 
	[ ] INTEGER iBoxcar5 
	[ ] INTEGER iVMin1 
	[ ] INTEGER iVMax1 
	[ ] INTEGER iVMin2  
	[ ] INTEGER iVMax2 
	[ ] INTEGER iVMin3 
	[ ] INTEGER iVMax3 
	[ ] INTEGER iVMin4  
	[ ] INTEGER iVMax4 
	[ ] INTEGER iVMin5 
	[ ] INTEGER iVMax5 
	[ ] INTEGER iUseEndPt1
	[ ] INTEGER iUseEndPt2
	[ ] INTEGER iUseEndPt3
	[ ] INTEGER iUseEndPt4
	[ ] INTEGER iUseEndPt5
	[ ] INTEGER iEndPt1
	[ ] INTEGER iEndPt2
	[ ] INTEGER iEndPt3
	[ ] INTEGER iEndPt4
	[ ] INTEGER iEndPt5
	[ ] INTEGER iCurveFit
	[ ] INTEGER iSignalLoss
	[ ] INTEGER iNumberCyclesInStage
	[ ] STRING sOrganismDetail
	[ ] STRING sDefaultResultText
	[ ] STRING sDefaultResultColor
[ ] 
[+] type REC_6ANALYTES_OR is record
	[ ] STRING sNAME  
	[ ] STRING sAnalyteName1 
	[ ] STRING sReporter1 
	[ ] STRING sAnalyteName2 
	[ ] STRING sReporter2 
	[ ] STRING sAnalyteName3 
	[ ] STRING sReporter3 
	[ ] STRING sAnalyteName4 
	[ ] STRING sReporter4 
	[ ] STRING sAnalyteName5 
	[ ] STRING sReporter5 
	[ ] STRING sAnalyteName6 
	[ ] STRING sReporter6 
	[ ] STRING sUsage1 
	[ ] STRING sUsage2  
	[ ] STRING sUsage3 
	[ ] STRING sUsage4  
	[ ] STRING sUsage5 
	[ ] STRING sUsage6  
	[ ] INTEGER iAnalyteTargetIC1
	[ ] INTEGER iSelectTarget1ForIC
	[ ] INTEGER iAnalyteTargetIC2
	[ ] INTEGER iSelectTarget2ForIC
	[ ] INTEGER iAnalyteTargetIC3
	[ ] INTEGER iSelectTarget3ForIC
	[ ] INTEGER iAnalyteTargetIC4
	[ ] INTEGER iSelectTarget4ForIC
	[ ] INTEGER iAnalyteTargetIC5
	[ ] INTEGER iSelectTarget5ForIC
	[ ] INTEGER iAnalyteTargetSPC1
	[ ] INTEGER iSelectTarget1ForSPC
	[ ] INTEGER iAnalyteTargetSPC2
	[ ] INTEGER iSelectTarget2ForSPC
	[ ] INTEGER iAnalyteTargetSPC3
	[ ] INTEGER iSelectTarget3ForSPC
	[ ] INTEGER iAnalyteTargetSPC4
	[ ] INTEGER iSelectTarget4ForSPC
	[ ] INTEGER iAnalyteTargetSPC5
	[ ] INTEGER iSelectTarget5ForSPC
	[ ] INTEGER iAnalyteTargetEC1
	[ ] INTEGER iSelectTarget1ForEC
	[ ] INTEGER iAnalyteTargetEC2
	[ ] INTEGER iSelectTarget2ForEC
	[ ] INTEGER iAnalyteTargetEC3
	[ ] INTEGER iSelectTarget3ForEC
	[ ] INTEGER iAnalyteTargetEC4
	[ ] INTEGER iSelectTarget4ForEC
	[ ] INTEGER iAnalyteTargetEC5
	[ ] INTEGER iSelectTarget5ForEC
	[ ] INTEGER iBkgndSub  
	[ ] INTEGER iBkgndVMin1 
	[ ] INTEGER iBkgndVMax1 
	[ ] INTEGER iBkgndVMin2  
	[ ] INTEGER iBkgndVMax2 
	[ ] INTEGER iBkgndVMin3 
	[ ] INTEGER iBkgndVMax3 
	[ ] INTEGER iBkgndVMin4  
	[ ] INTEGER iBkgndVMax4 
	[ ] INTEGER iBkgndVMin5 
	[ ] INTEGER iBkgndVMax5 
	[ ] INTEGER iBkgndVMin6  
	[ ] INTEGER iBkgndVMax6 
	[ ] REAL rThreshold1 
	[ ] REAL rThreshold2 
	[ ] REAL rThreshold3 
	[ ] REAL rThreshold4 
	[ ] REAL rThreshold5 
	[ ] REAL rThreshold6 
	[ ] STRING sCurveAnalysis1
	[ ] STRING sCurveAnalysis2
	[ ] STRING sCurveAnalysis3
	[ ] STRING sCurveAnalysis4
	[ ] STRING sCurveAnalysis5
	[ ] STRING sCurveAnalysis6
	[ ] INTEGER iBoxcar1 
	[ ] INTEGER iBoxcar2 
	[ ] INTEGER iBoxcar3 
	[ ] INTEGER iBoxcar4 
	[ ] INTEGER iBoxcar5 
	[ ] INTEGER iBoxcar6 
	[ ] INTEGER iVMin1 
	[ ] INTEGER iVMax1 
	[ ] INTEGER iVMin2  
	[ ] INTEGER iVMax2 
	[ ] INTEGER iVMin3 
	[ ] INTEGER iVMax3 
	[ ] INTEGER iVMin4  
	[ ] INTEGER iVMax4 
	[ ] INTEGER iVMin5 
	[ ] INTEGER iVMax5 
	[ ] INTEGER iVMin6  
	[ ] INTEGER iVMax6 
	[ ] INTEGER iUseEndPt1
	[ ] INTEGER iUseEndPt2
	[ ] INTEGER iUseEndPt3
	[ ] INTEGER iUseEndPt4
	[ ] INTEGER iUseEndPt5
	[ ] INTEGER iUseEndPt6
	[ ] INTEGER iEndPt1
	[ ] INTEGER iEndPt2
	[ ] INTEGER iEndPt3
	[ ] INTEGER iEndPt4
	[ ] INTEGER iEndPt5
	[ ] INTEGER iEndPt6
	[ ] INTEGER iCurveFit
	[ ] INTEGER iSignalLoss
	[ ] INTEGER iNumberCyclesInStage
	[ ] STRING sOrganismDetail
	[ ] STRING sDefaultResultText
	[ ] STRING sDefaultResultColor
[ ] 
[+] type REC_ORGANISM is record
	[ ] STRING sOrganismName
	[ ] STRING sCheck1
	[ ] STRING sCheck2
	[ ] STRING sCheck3
	[ ] STRING sCheck4
	[ ] STRING sCheck5
	[ ] STRING sCheck6
	[ ] STRING sType
	[ ] INTEGER iNumAnalytes
	[ ] STRING sCustomize
	[ ] INTEGER iPosition
[ ] 
[+] type REC_ORGANISM_SEMI is record
	[ ] STRING sOrganismName
	[ ] STRING sCheck1
	[ ] STRING sCheck2
	[ ] STRING sCheck3
	[ ] STRING sCheck4
	[ ] STRING sCheck5
	[ ] STRING sCheck6
	[ ] STRING sType
	[ ] INTEGER iNumAnalytes
	[ ] STRING sCustomize
	[ ] INTEGER iPosition
	[ ] STRING sSemiQuant
[ ] 
[+] type REC_SEMI_DETAIL is record
	[ ] STRING sQuantResultText
	[ ] STRING sDeltaCtMin
	[ ] STRING sReplacedResultText
	[ ] STRING sReplacedResultColor
	[ ] STRING sMediumCtMin
	[ ] STRING sLowCtMin
	[ ] STRING sVeryLowCtMin
[ ] 
[+] type REC_ORGANISM_DELTA is record
	[ ] STRING sOrganismName
	[ ] STRING sCheck1
	[ ] STRING sCheck2
	[ ] STRING sCheck3
	[ ] STRING sCheck4
	[ ] STRING sCheck5
	[ ] STRING sCheck6
	[ ] STRING sType
	[ ] INTEGER iNumAnalytes
	[ ] STRING sCustomize
	[ ] INTEGER iPosition
	[ ] STRING rDeltaCtMin
	[ ] STRING rDeltaCtMax
[ ] 
[+] type REC_ORGANISM_COMBO is record
	[ ] STRING sOrganismName
	[ ] STRING sCheck1
	[ ] STRING sCheck2
	[ ] STRING sCheck3
	[ ] STRING sCheck4
	[ ] STRING sCheck5
	[ ] STRING sCheck6
	[ ] STRING sType
	[ ] INTEGER iNumAnalytes
	[ ] STRING sCustomize
	[ ] INTEGER iPosition
	[ ] STRING sSemiQuant
	[ ] STRING rDeltaCtMin
	[ ] STRING rDeltaCtMax
[ ] 
[+] type REC_DELTA_DETAIL is record
	[ ] STRING sOrganismName
	[ ] STRING sCondition
	[ ] STRING sResultText
	[ ] STRING sResultColor
[ ] 
[+] type REC_CUSTOMIZE is record
	[ ] STRING sOrganismName
	[ ] STRING sAnalyte1
	[ ] STRING sAnalyte2
	[ ] STRING sAnalyte3
	[ ] STRING sAnalyte4
	[ ] STRING sAnalyte5
	[ ] STRING sAnalyte6
	[ ] STRING sResultText
	[ ] STRING sResultColor
[ ] 
[+] type ASSAY_DISCLAIMERS is record
	[ ] STRING sAssayDisclaimer
	[ ] STRING sLightBlueDisclaimer
	[ ] STRING sLightGrayDisclaimer
	[ ] STRING sRedDisclaimer
	[ ] STRING sGreenDisclaimer
	[ ] STRING sYellowDisclaimer
	[ ] STRING sWhiteDisclaimer
[ ] 
[+] type REC_6ANALYTESORT34 is record
	[ ] STRING sNAME  
	[ ] STRING sAnalyteName1 
	[ ] STRING sReporter1 
	[ ] STRING sAnalyteName2 
	[ ] STRING sReporter2 
	[ ] STRING sAnalyteName3 
	[ ] STRING sReporter3 
	[ ] STRING sAnalyteName4 
	[ ] STRING sReporter4 
	[ ] STRING sAnalyteName5 
	[ ] STRING sReporter5 
	[ ] STRING sAnalyteName6 
	[ ] STRING sReporter6 
	[ ] STRING sUsage1 
	[ ] STRING sUsage2  
	[ ] STRING sUsage3 
	[ ] STRING sUsage4  
	[ ] STRING sUsage5 
	[ ] STRING sUsage6  
	[ ] INTEGER iAnalyteTargetIC1
	[ ] INTEGER iSelectTarget1ForIC
	[ ] INTEGER iAnalyteTargetIC2
	[ ] INTEGER iSelectTarget2ForIC
	[ ] INTEGER iAnalyteTargetIC3
	[ ] INTEGER iSelectTarget3ForIC
	[ ] INTEGER iAnalyteTargetIC4
	[ ] INTEGER iSelectTarget4ForIC
	[ ] INTEGER iAnalyteTargetIC5
	[ ] INTEGER iSelectTarget5ForIC
	[ ] INTEGER iAnalyteTargetSPC1
	[ ] INTEGER iSelectTarget1ForSPC
	[ ] INTEGER iAnalyteTargetSPC2
	[ ] INTEGER iSelectTarget2ForSPC
	[ ] INTEGER iAnalyteTargetSPC3
	[ ] INTEGER iSelectTarget3ForSPC
	[ ] INTEGER iAnalyteTargetSPC4
	[ ] INTEGER iSelectTarget4ForSPC
	[ ] INTEGER iAnalyteTargetSPC5
	[ ] INTEGER iSelectTarget5ForSPC
	[ ] INTEGER iAnalyteTargetEC1
	[ ] INTEGER iSelectTarget1ForEC
	[ ] INTEGER iAnalyteTargetEC2
	[ ] INTEGER iSelectTarget2ForEC
	[ ] INTEGER iAnalyteTargetEC3
	[ ] INTEGER iSelectTarget3ForEC
	[ ] INTEGER iAnalyteTargetEC4
	[ ] INTEGER iSelectTarget4ForEC
	[ ] INTEGER iAnalyteTargetEC5
	[ ] INTEGER iSelectTarget5ForEC
	[ ] INTEGER iBkgndSub  
	[ ] INTEGER iBkgndVMin1 
	[ ] INTEGER iBkgndVMax1 
	[ ] INTEGER iBkgndVMin2  
	[ ] INTEGER iBkgndVMax2 
	[ ] INTEGER iBkgndVMin3 
	[ ] INTEGER iBkgndVMax3 
	[ ] INTEGER iBkgndVMin4  
	[ ] INTEGER iBkgndVMax4 
	[ ] INTEGER iBkgndVMin5 
	[ ] INTEGER iBkgndVMax5 
	[ ] INTEGER iBkgndVMin6  
	[ ] INTEGER iBkgndVMax6 
	[ ] REAL rThreshold1 
	[ ] REAL rThreshold2 
	[ ] REAL rThreshold3 
	[ ] REAL rThreshold4 
	[ ] REAL rThreshold5 
	[ ] REAL rThreshold6 
	[ ] STRING sCurveAnalysis1
	[ ] STRING sCurveAnalysis2
	[ ] STRING sCurveAnalysis3
	[ ] STRING sCurveAnalysis4
	[ ] STRING sCurveAnalysis5
	[ ] STRING sCurveAnalysis6
	[ ] INTEGER iBoxcar1 
	[ ] INTEGER iBoxcar2 
	[ ] INTEGER iBoxcar3 
	[ ] INTEGER iBoxcar4 
	[ ] INTEGER iBoxcar5 
	[ ] INTEGER iBoxcar6 
	[ ] INTEGER iVMin1 
	[ ] INTEGER iVMax1 
	[ ] INTEGER iVMin2  
	[ ] INTEGER iVMax2 
	[ ] INTEGER iVMin3 
	[ ] INTEGER iVMax3 
	[ ] INTEGER iVMin4  
	[ ] INTEGER iVMax4 
	[ ] INTEGER iVMin5 
	[ ] INTEGER iVMax5 
	[ ] INTEGER iVMin6  
	[ ] INTEGER iVMax6 
	[ ] INTEGER iUseEndPt1
	[ ] INTEGER iUseEndPt2
	[ ] INTEGER iUseEndPt3
	[ ] INTEGER iUseEndPt4
	[ ] INTEGER iUseEndPt5
	[ ] INTEGER iUseEndPt6
	[ ] INTEGER iEndPt1
	[ ] INTEGER iEndPt2
	[ ] INTEGER iEndPt3
	[ ] INTEGER iEndPt4
	[ ] INTEGER iEndPt5
	[ ] INTEGER iEndPt6
	[ ] INTEGER iNormFactor1
	[ ] INTEGER iNormFactor2
	[ ] INTEGER iNormFactor3
	[ ] INTEGER iNormFactor4
	[ ] INTEGER iNormFactor5
	[ ] INTEGER iNormFactor6
	[ ] INTEGER iPrbChkMax1
	[ ] INTEGER iPrbChkMax2
	[ ] INTEGER iPrbChkMax3
	[ ] INTEGER iPrbChkMax4
	[ ] INTEGER iPrbChkMax5
	[ ] INTEGER iPrbChkMax6
	[ ] INTEGER iPrbChkMin1
	[ ] INTEGER iPrbChkMin2
	[ ] INTEGER iPrbChkMin3
	[ ] INTEGER iPrbChkMin4
	[ ] INTEGER iPrbChkMin5
	[ ] INTEGER iPrbChkMin6
	[ ] INTEGER iCurveFit
	[ ] INTEGER iSignalLoss
	[ ] INTEGER iNumberCyclesInStage
	[ ] STRING sOrganismDetail
	[ ] STRING sDefaultResultText
	[ ] STRING sDefaultResultColor
[ ] 
[ ] 
[ ] 
[ ] // the _GT indicated that the type is used by D8382 Genotyping
[+] type REC_2ANALYTES_GT is record
	[ ] STRING sNAME  
	[ ] STRING sAnalyteName1 
	[ ] STRING sReporter1 
	[ ] STRING sAnalyteName2 
	[ ] STRING sReporter2 
	[ ] STRING sUsage1 
	[ ] STRING sUsage2  
	[ ] INTEGER iBkgndSub  
	[ ] INTEGER iBkgndVMin1 
	[ ] INTEGER iBkgndVMax1 
	[ ] INTEGER iBkgndVMin2  
	[ ] INTEGER iBkgndVMax2 
	[ ] REAL rThreshold1 
	[ ] REAL rThreshold2 
	[ ] STRING sCurveAnalysis1
	[ ] STRING sCurveAnalysis2
	[ ] INTEGER iBoxcar1 
	[ ] INTEGER iBoxcar2 
	[ ] INTEGER iVMin1 
	[ ] INTEGER iVMax1 
	[ ] INTEGER iVMin2  
	[ ] INTEGER iVMax2 
	[ ] INTEGER iUseEndPt1
	[ ] INTEGER iUseEndPt2
	[ ] INTEGER iEndPt1
	[ ] INTEGER iEndPt2
	[ ] STRING sInvalidBias1
	[ ] STRING sInvalidBias2
	[ ] INTEGER iCurveFit
	[ ] INTEGER iSignalLoss
	[ ] INTEGER iNumberCyclesInStage
	[ ] STRING sGenotypingDetail
	[ ] STRING sDefaultResultText
	[ ] STRING sDefaultResultColor
	[ ] STRING sDisclaimers
[ ] 
[+] type REC_4ANALYTES_GT is record
	[ ] STRING sNAME  
	[ ] STRING sAnalyteName1 
	[ ] STRING sReporter1 
	[ ] STRING sAnalyteName2 
	[ ] STRING sReporter2 
	[ ] STRING sAnalyteName3 
	[ ] STRING sReporter3 
	[ ] STRING sAnalyteName4 
	[ ] STRING sReporter4 
	[ ] STRING sUsage1 
	[ ] STRING sUsage2  
	[ ] STRING sUsage3 
	[ ] STRING sUsage4  
	[ ] INTEGER iBkgndSub  
	[ ] INTEGER iBkgndVMin1 
	[ ] INTEGER iBkgndVMax1 
	[ ] INTEGER iBkgndVMin2  
	[ ] INTEGER iBkgndVMax2 
	[ ] INTEGER iBkgndVMin3 
	[ ] INTEGER iBkgndVMax3 
	[ ] INTEGER iBkgndVMin4  
	[ ] INTEGER iBkgndVMax4 
	[ ] REAL rThreshold1 
	[ ] REAL rThreshold2 
	[ ] REAL rThreshold3 
	[ ] REAL rThreshold4 
	[ ] STRING sCurveAnalysis1
	[ ] STRING sCurveAnalysis2
	[ ] STRING sCurveAnalysis3
	[ ] STRING sCurveAnalysis4
	[ ] INTEGER iBoxcar1 
	[ ] INTEGER iBoxcar2 
	[ ] INTEGER iBoxcar3 
	[ ] INTEGER iBoxcar4 
	[ ] INTEGER iVMin1 
	[ ] INTEGER iVMax1 
	[ ] INTEGER iVMin2  
	[ ] INTEGER iVMax2 
	[ ] INTEGER iVMin3 
	[ ] INTEGER iVMax3 
	[ ] INTEGER iVMin4  
	[ ] INTEGER iVMax4 
	[ ] INTEGER iUseEndPt1
	[ ] INTEGER iUseEndPt2
	[ ] INTEGER iUseEndPt3
	[ ] INTEGER iUseEndPt4
	[ ] INTEGER iEndPt1
	[ ] INTEGER iEndPt2
	[ ] INTEGER iEndPt3
	[ ] INTEGER iEndPt4
	[ ] STRING sInvalidBias1
	[ ] STRING sInvalidBias2
	[ ] STRING sInvalidBias3
	[ ] STRING sInvalidBias4
	[ ] INTEGER iCurveFit
	[ ] INTEGER iSignalLoss
	[ ] INTEGER iNumberCyclesInStage
	[ ] STRING sGenotypingDetail
	[ ] STRING sDefaultResultText
	[ ] STRING sDefaultResultColor
	[ ] STRING sDisclaimers
[ ] 
[+] type REC_4ANALYTESCOMBO is record
	[ ] STRING sNAME  
	[ ] STRING sAnalyteName1 
	[ ] STRING sReporter1 
	[ ] STRING sAnalyteName2 
	[ ] STRING sReporter2 
	[ ] STRING sAnalyteName3 
	[ ] STRING sReporter3 
	[ ] STRING sAnalyteName4 
	[ ] STRING sReporter4 
	[ ] STRING sUsage1 
	[ ] STRING sUsage2  
	[ ] STRING sUsage3 
	[ ] STRING sUsage4  
	[ ] INTEGER iBkgndSub  
	[ ] INTEGER iBkgndVMin1 
	[ ] INTEGER iBkgndVMax1 
	[ ] INTEGER iBkgndVMin2  
	[ ] INTEGER iBkgndVMax2 
	[ ] INTEGER iBkgndVMin3 
	[ ] INTEGER iBkgndVMax3 
	[ ] INTEGER iBkgndVMin4  
	[ ] INTEGER iBkgndVMax4 
	[ ] REAL rThreshold1 
	[ ] REAL rThreshold2 
	[ ] REAL rThreshold3 
	[ ] REAL rThreshold4 
	[ ] STRING sCurveAnalysis1
	[ ] STRING sCurveAnalysis2
	[ ] STRING sCurveAnalysis3
	[ ] STRING sCurveAnalysis4
	[ ] INTEGER iNormFactor1 
	[ ] INTEGER iNormFactor2 
	[ ] INTEGER iNormFactor3 
	[ ] INTEGER iNormFactor4 
	[ ] INTEGER iBoxcar1 
	[ ] INTEGER iBoxcar2 
	[ ] INTEGER iBoxcar3 
	[ ] INTEGER iBoxcar4 
	[ ] INTEGER iVMin1 
	[ ] INTEGER iVMax1 
	[ ] INTEGER iVMin2  
	[ ] INTEGER iVMax2 
	[ ] INTEGER iVMin3 
	[ ] INTEGER iVMax3 
	[ ] INTEGER iVMin4  
	[ ] INTEGER iVMax4 
	[ ] INTEGER iUseEndPt1
	[ ] INTEGER iUseEndPt2
	[ ] INTEGER iUseEndPt3
	[ ] INTEGER iUseEndPt4
	[ ] INTEGER iEndPt1
	[ ] INTEGER iEndPt2
	[ ] INTEGER iEndPt3
	[ ] INTEGER iEndPt4
	[ ] INTEGER iPrbChkMax1
	[ ] INTEGER iPrbChkMax2
	[ ] INTEGER iPrbChkMax3
	[ ] INTEGER iPrbChkMax4
	[ ] INTEGER iPrbChkMin1
	[ ] INTEGER iPrbChkMin2
	[ ] INTEGER iPrbChkMin3
	[ ] INTEGER iPrbChkMin4
	[ ] STRING sInvalidBias1
	[ ] STRING sInvalidBias2
	[ ] STRING sInvalidBias3
	[ ] STRING sInvalidBias4
	[ ] INTEGER iCurveFit
	[ ] INTEGER iSignalLoss
	[ ] INTEGER iNumberCyclesInStage
	[ ] STRING sGenotypingDetail
	[ ] STRING sDefaultResultText
	[ ] STRING sDefaultResultColor
	[ ] STRING sDisclaimers
[ ] 
[+] type REC_6ANALYTES_GT is record
	[ ] STRING sNAME  
	[ ] STRING sAnalyteName1 
	[ ] STRING sReporter1 
	[ ] STRING sAnalyteName2 
	[ ] STRING sReporter2 
	[ ] STRING sAnalyteName3 
	[ ] STRING sReporter3 
	[ ] STRING sAnalyteName4 
	[ ] STRING sReporter4 
	[ ] STRING sAnalyteName5 
	[ ] STRING sReporter5 
	[ ] STRING sAnalyteName6 
	[ ] STRING sReporter6 
	[ ] STRING sUsage1 
	[ ] STRING sUsage2  
	[ ] STRING sUsage3 
	[ ] STRING sUsage4  
	[ ] STRING sUsage5 
	[ ] STRING sUsage6  
	[ ] INTEGER iBkgndSub  
	[ ] INTEGER iBkgndVMin1 
	[ ] INTEGER iBkgndVMax1 
	[ ] INTEGER iBkgndVMin2  
	[ ] INTEGER iBkgndVMax2 
	[ ] INTEGER iBkgndVMin3 
	[ ] INTEGER iBkgndVMax3 
	[ ] INTEGER iBkgndVMin4  
	[ ] INTEGER iBkgndVMax4 
	[ ] INTEGER iBkgndVMin5 
	[ ] INTEGER iBkgndVMax5 
	[ ] INTEGER iBkgndVMin6  
	[ ] INTEGER iBkgndVMax6 
	[ ] REAL rThreshold1 
	[ ] REAL rThreshold2 
	[ ] REAL rThreshold3 
	[ ] REAL rThreshold4 
	[ ] REAL rThreshold5 
	[ ] REAL rThreshold6 
	[ ] STRING sCurveAnalysis1
	[ ] STRING sCurveAnalysis2
	[ ] STRING sCurveAnalysis3
	[ ] STRING sCurveAnalysis4
	[ ] STRING sCurveAnalysis5
	[ ] STRING sCurveAnalysis6
	[ ] INTEGER iBoxcar1 
	[ ] INTEGER iBoxcar2 
	[ ] INTEGER iBoxcar3 
	[ ] INTEGER iBoxcar4 
	[ ] INTEGER iBoxcar5 
	[ ] INTEGER iBoxcar6 
	[ ] INTEGER iVMin1 
	[ ] INTEGER iVMax1 
	[ ] INTEGER iVMin2  
	[ ] INTEGER iVMax2 
	[ ] INTEGER iVMin3 
	[ ] INTEGER iVMax3 
	[ ] INTEGER iVMin4  
	[ ] INTEGER iVMax4 
	[ ] INTEGER iVMin5 
	[ ] INTEGER iVMax5 
	[ ] INTEGER iVMin6  
	[ ] INTEGER iVMax6 
	[ ] INTEGER iUseEndPt1
	[ ] INTEGER iUseEndPt2
	[ ] INTEGER iUseEndPt3
	[ ] INTEGER iUseEndPt4
	[ ] INTEGER iUseEndPt5
	[ ] INTEGER iUseEndPt6
	[ ] INTEGER iEndPt1
	[ ] INTEGER iEndPt2
	[ ] INTEGER iEndPt3
	[ ] INTEGER iEndPt4
	[ ] INTEGER iEndPt5
	[ ] INTEGER iEndPt6
	[ ] STRING sInvalidBias1
	[ ] STRING sInvalidBias2
	[ ] STRING sInvalidBias3
	[ ] STRING sInvalidBias4
	[ ] STRING sInvalidBias5
	[ ] STRING sInvalidBias6
	[ ] INTEGER iCurveFit
	[ ] INTEGER iSignalLoss
	[ ] INTEGER iNumberCyclesInStage
	[ ] STRING sGenotypingDetail
	[ ] STRING sDefaultResultText
	[ ] STRING sDefaultResultColor
	[ ] STRING sDisclaimers
[ ] 
[+] type REC_CUSTOMIZE_GT is record
	[ ] STRING sGenotypingName
	[ ] STRING sAnalyte1
	[ ] STRING sAnalyte2
	[ ] STRING sAnalyte3
	[ ] STRING sAnalyte4
	[ ] STRING sAnalyte5
	[ ] STRING sAnalyte6
	[ ] STRING sEarlyDeltaCtMax
	[ ] STRING sLateDeltaCtMax
	[ ] STRING sCustomize
	[ ] INTEGER iPosition
[ ] 
[+] type REC_GENOTYPING_DETAIL is record
	[ ] STRING sAnalyte1
	[ ] STRING sAnalyte2
	[ ] STRING sDeltaCtResult
	[ ] STRING sResultText
	[ ] STRING sResultColor
[ ] 
[ ] // The following data types are used for Haplotype processing
[+] type REC_2ANALYTES_HP is record
	[ ] STRING sNAME  
	[ ] STRING sAnalyteName1 
	[ ] STRING sReporter1 
	[ ] STRING sAnalyteName2 
	[ ] STRING sReporter2 
	[ ] STRING sUsage1 
	[ ] STRING sUsage2  
	[ ] INTEGER iBkgndSub  
	[ ] INTEGER iBkgndVMin1 
	[ ] INTEGER iBkgndVMax1 
	[ ] INTEGER iBkgndVMin2  
	[ ] INTEGER iBkgndVMax2 
	[ ] REAL rThreshold1 
	[ ] REAL rThreshold2 
	[ ] STRING sCurveAnalysis1
	[ ] STRING sCurveAnalysis2
	[ ] INTEGER iBoxcar1 
	[ ] INTEGER iBoxcar2 
	[ ] INTEGER iVMin1 
	[ ] INTEGER iVMax1 
	[ ] INTEGER iVMin2  
	[ ] INTEGER iVMax2 
	[ ] INTEGER iUseEndPt1
	[ ] INTEGER iUseEndPt2
	[ ] INTEGER iEndPt1
	[ ] INTEGER iEndPt2
	[ ] STRING sInvalidBias1
	[ ] STRING sInvalidBias2
	[ ] INTEGER iCurveFit
	[ ] INTEGER iSignalLoss
	[ ] INTEGER iNumberCyclesInStage
	[ ] STRING sGenotypingDetail
	[ ] STRING sDefaultResultText
	[ ] STRING sDefaultResultColor
	[ ] STRING sDisclaimers
	[ ] STRING sHaplotype
[ ] 
[+] type REC_4ANALYTES_HP is record
	[ ] STRING sNAME  
	[ ] STRING sAnalyteName1 
	[ ] STRING sReporter1 
	[ ] STRING sAnalyteName2 
	[ ] STRING sReporter2 
	[ ] STRING sAnalyteName3 
	[ ] STRING sReporter3 
	[ ] STRING sAnalyteName4 
	[ ] STRING sReporter4 
	[ ] STRING sUsage1 
	[ ] STRING sUsage2  
	[ ] STRING sUsage3 
	[ ] STRING sUsage4  
	[ ] INTEGER iBkgndSub  
	[ ] INTEGER iBkgndVMin1 
	[ ] INTEGER iBkgndVMax1 
	[ ] INTEGER iBkgndVMin2  
	[ ] INTEGER iBkgndVMax2 
	[ ] INTEGER iBkgndVMin3 
	[ ] INTEGER iBkgndVMax3 
	[ ] INTEGER iBkgndVMin4  
	[ ] INTEGER iBkgndVMax4 
	[ ] REAL rThreshold1 
	[ ] REAL rThreshold2 
	[ ] REAL rThreshold3 
	[ ] REAL rThreshold4 
	[ ] STRING sCurveAnalysis1
	[ ] STRING sCurveAnalysis2
	[ ] STRING sCurveAnalysis3
	[ ] STRING sCurveAnalysis4
	[ ] INTEGER iBoxcar1 
	[ ] INTEGER iBoxcar2 
	[ ] INTEGER iBoxcar3 
	[ ] INTEGER iBoxcar4 
	[ ] INTEGER iVMin1 
	[ ] INTEGER iVMax1 
	[ ] INTEGER iVMin2  
	[ ] INTEGER iVMax2 
	[ ] INTEGER iVMin3 
	[ ] INTEGER iVMax3 
	[ ] INTEGER iVMin4  
	[ ] INTEGER iVMax4 
	[ ] INTEGER iUseEndPt1
	[ ] INTEGER iUseEndPt2
	[ ] INTEGER iUseEndPt3
	[ ] INTEGER iUseEndPt4
	[ ] INTEGER iEndPt1
	[ ] INTEGER iEndPt2
	[ ] INTEGER iEndPt3
	[ ] INTEGER iEndPt4
	[ ] STRING sInvalidBias1
	[ ] STRING sInvalidBias2
	[ ] STRING sInvalidBias3
	[ ] STRING sInvalidBias4
	[ ] INTEGER iCurveFit
	[ ] INTEGER iSignalLoss
	[ ] INTEGER iNumberCyclesInStage
	[ ] STRING sGenotypingDetail
	[ ] STRING sDefaultResultText
	[ ] STRING sDefaultResultColor
	[ ] STRING sDisclaimers
	[ ] STRING sHaplotype
[ ] 
[+] type REC_6ANALYTES_HP is record
	[ ] STRING sNAME  
	[ ] STRING sAnalyteName1 
	[ ] STRING sReporter1 
	[ ] STRING sAnalyteName2 
	[ ] STRING sReporter2 
	[ ] STRING sAnalyteName3 
	[ ] STRING sReporter3 
	[ ] STRING sAnalyteName4 
	[ ] STRING sReporter4 
	[ ] STRING sAnalyteName5 
	[ ] STRING sReporter5 
	[ ] STRING sAnalyteName6 
	[ ] STRING sReporter6 
	[ ] STRING sUsage1 
	[ ] STRING sUsage2  
	[ ] STRING sUsage3 
	[ ] STRING sUsage4  
	[ ] STRING sUsage5 
	[ ] STRING sUsage6  
	[ ] INTEGER iBkgndSub  
	[ ] INTEGER iBkgndVMin1 
	[ ] INTEGER iBkgndVMax1 
	[ ] INTEGER iBkgndVMin2  
	[ ] INTEGER iBkgndVMax2 
	[ ] INTEGER iBkgndVMin3 
	[ ] INTEGER iBkgndVMax3 
	[ ] INTEGER iBkgndVMin4  
	[ ] INTEGER iBkgndVMax4 
	[ ] INTEGER iBkgndVMin5 
	[ ] INTEGER iBkgndVMax5 
	[ ] INTEGER iBkgndVMin6  
	[ ] INTEGER iBkgndVMax6 
	[ ] REAL rThreshold1 
	[ ] REAL rThreshold2 
	[ ] REAL rThreshold3 
	[ ] REAL rThreshold4 
	[ ] REAL rThreshold5 
	[ ] REAL rThreshold6 
	[ ] STRING sCurveAnalysis1
	[ ] STRING sCurveAnalysis2
	[ ] STRING sCurveAnalysis3
	[ ] STRING sCurveAnalysis4
	[ ] STRING sCurveAnalysis5
	[ ] STRING sCurveAnalysis6
	[ ] INTEGER iBoxcar1 
	[ ] INTEGER iBoxcar2 
	[ ] INTEGER iBoxcar3 
	[ ] INTEGER iBoxcar4 
	[ ] INTEGER iBoxcar5 
	[ ] INTEGER iBoxcar6 
	[ ] INTEGER iVMin1 
	[ ] INTEGER iVMax1 
	[ ] INTEGER iVMin2  
	[ ] INTEGER iVMax2 
	[ ] INTEGER iVMin3 
	[ ] INTEGER iVMax3 
	[ ] INTEGER iVMin4  
	[ ] INTEGER iVMax4 
	[ ] INTEGER iVMin5 
	[ ] INTEGER iVMax5 
	[ ] INTEGER iVMin6  
	[ ] INTEGER iVMax6 
	[ ] INTEGER iUseEndPt1
	[ ] INTEGER iUseEndPt2
	[ ] INTEGER iUseEndPt3
	[ ] INTEGER iUseEndPt4
	[ ] INTEGER iUseEndPt5
	[ ] INTEGER iUseEndPt6
	[ ] INTEGER iEndPt1
	[ ] INTEGER iEndPt2
	[ ] INTEGER iEndPt3
	[ ] INTEGER iEndPt4
	[ ] INTEGER iEndPt5
	[ ] INTEGER iEndPt6
	[ ] STRING sInvalidBias1
	[ ] STRING sInvalidBias2
	[ ] STRING sInvalidBias3
	[ ] STRING sInvalidBias4
	[ ] STRING sInvalidBias5
	[ ] STRING sInvalidBias6
	[ ] INTEGER iCurveFit
	[ ] INTEGER iSignalLoss
	[ ] INTEGER iNumberCyclesInStage
	[ ] STRING sGenotypingDetail
	[ ] STRING sDefaultResultText
	[ ] STRING sDefaultResultColor
	[ ] STRING sDisclaimers
	[ ] STRING sHaplotype
[ ] 
[+] type REC_CUSTOMIZE_HP is record
	[ ] STRING sGenotypingName
	[ ] STRING sAnalyte1
	[ ] STRING sAnalyte2
	[ ] STRING sAnalyte3
	[ ] STRING sAnalyte4
	[ ] STRING sAnalyte5
	[ ] STRING sAnalyte6
	[ ] STRING sAnalyte7
	[ ] STRING sAnalyte8
	[ ] STRING sAnalyte9
	[ ] STRING sAnalyte10
	[ ] STRING sAnalyte11
	[ ] STRING sAnalyte12
	[ ] STRING sEarlyDeltaCtMax
	[ ] STRING sLateDeltaCtMax
	[ ] STRING sCustomize
	[ ] INTEGER iPosition
[ ] 
[+] type REC_HAPLOTYPE is record
	[ ] STRING sHaplotypeName
	[ ] STRING sHaplotypeDetail
	[ ] STRING sGene1
	[ ] STRING sGene2
	[ ] STRING sGene3
	[ ] STRING sGene4
	[ ] INTEGER iPosition
[ ] 
[+] type REC_HAPLOTYPE_DETAIL is record
	[ ] STRING sGene1
	[ ] STRING sGene2
	[ ] STRING sGene3
	[ ] STRING sAllele1
	[ ] STRING sAllele2
	[ ] STRING sResultColor
[ ] 
[ ] 
